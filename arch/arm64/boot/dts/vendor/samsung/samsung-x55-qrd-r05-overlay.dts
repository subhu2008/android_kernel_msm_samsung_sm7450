/dts-v1/;
/plugin/;

#include "diwali-qrd.dtsi"
#include "diwali-qrd-pm7250b.dtsi"
#include "x55/x55-common.dtsi"

/ {
	model = "Qualcomm Technologies, Inc. Diwali QRD DVT1";
	compatible = "qcom,diwali-qrd", "qcom,diwali", "qcom,qrd";
	qcom,msm-id = <506 0x10000>, <547 0x10000>, <564 0x10000>;
	qcom,board-id = <0x1000B 0x5>;
	qcom,pmic-id-size = <9>;
	qcom,pmic-id = <0x0 0x0 0x0 0x0 0x0 0x0 0x0 0x0 0x2E>;
};
